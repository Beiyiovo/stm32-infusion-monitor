/**
 ******************************************************************************
 *  502 步骤 7：滴速检测（红外对射）
 ******************************************************************************
 *  接线：发射头 VCC→3V3  GND→GND；接收头 VCC→3V3  GND→GND  OUT→PB12
 *        两头夹在滴壶【壶体两侧】，加遮光罩
 *
 *  验收：
 *      1) 手在光路中挡一下再放开，滴数 +1（串口有计数）
 *      2) 连续遮挡 20 次，累计 = 20
 *      3) 正常滴液时，10 秒窗口结算一次，"滴/分"与人工数的一致（±1 滴）
 *      4) 手电筒直射时不乱跳（有遮光罩）
 *
 *  ★ 先用万用表确认：通光/遮光时 OUT 电平确实不同，再跑本程序
 ******************************************************************************
 */
#include "bsp.h"
#include "app502.h"
#include "drop.h"

int main(void)
{
    uint32_t n = 0;

    bsp_init();
    app502_init();
    uart1_init();
    drop_init();

    printf("\r\n[BOOT] 502 步骤7 · 滴速（红外对射）\r\n");
    printf("[DR] 每 10 秒结算一次；挡光一次应 +1 滴\r\n");

    while (1) {
        drop_tick();                     /* ★ 必须周期调用 */

        if ((millis() - n) >= 1000) {    /* 每秒打印一次累计 */
            n = millis();
            printf("[DR] 累计=%lu 滴  本窗口=%u 滴  滴速=%.1f 滴/分\r\n",
                   (unsigned long)drop_total(),
                   drop_window_drops(),
                   drop_rate_dpm());
            led_onboard((millis() / 1000) & 1);
        }

        /* KEY1 短按清零 */
        if (key_any_just_pressed() == 1) {
            drop_reset();
            printf("[DR] 已清零\r\n");
        }

        delay_ms(10);
    }
}
