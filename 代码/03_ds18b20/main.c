/**
 ******************************************************************************
 *  502 步骤 3：DS18B20 温度采集
 ******************************************************************************
 *  接线：DS18B20 红→3V3  黑→GND  黄(DQ)→PA0，并在 DQ–3V3 之间接 4.7kΩ 上拉
 *
 *  验收：串口每秒打印温度，室温应合理（20~30℃）；★ 若读到 85.0℃，
 *        说明读到的是上电默认值或没接上（本项目已丢弃第一次读数）
 ******************************************************************************
 */
#include "bsp.h"
#include "ds18b20.h"

int main(void)
{
    int16_t t;
    uint32_t n = 0;

    bsp_init();
    uart1_init();
    printf("\r\n[BOOT] 502 步骤3 · DS18B20 温度\r\n");

    ds18b20_init();
    printf("[DS] 初始化完成，开始读数（首次读数丢弃）\r\n");

    /* ★ 丢弃上电后的第一次读数（DS18B20 上电默认 85℃） */
    (void)ds18b20_get();

    while (1) {
        t = ds18b20_get();
        n++;

        if (t == DS18B20_ERR) {
            printf("[%lu] 读取失败：检查 4.7kΩ 上拉 / DQ 是否接 PA0 / 共地\r\n", (unsigned long)n);
        } else if (t == 850) {
            printf("[%lu] 读到 85.0℃：多半是没接上或上拉缺失\r\n", (unsigned long)n);
        } else {
            printf("[%lu] 温度 %d.%d ℃\r\n", (unsigned long)n, t / 10, (t % 10 + 10) % 10);
        }

        led_onboard(n & 1);
        delay_ms(1000);
    }
}
